#include "max7219.h"

void max7219_test(void);

static const unsigned char disp1[39][5]={
{0x1c,0x14,0x14,0x14,0x1c},//0
{0x1c,0x08,0x08,0x08,0x18},//1
{0x3c,0x20,0x3c,0x04,0x3c},//2
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{0x08,0x1c,0x3e,0x3e,0x14},//心
};

//--------------------------------------------
//功能：向MAX7219(U3)写入字节
//入口参数：DATA 
//出口参数：无
//说明：
void Write_Max7219_byte(unsigned char DATA)         
{
	unsigned char i;    
	Max7219_pinCS_L;	
//	HAL_Delay_us(2);	
	for(i=8;i>=1;i--)
	{		  
			Max7219_pinCLK_L;
		//	HAL_Delay_us(2);
			//Max7219_pinDIN=DATA>>7;
			if((DATA>>7)==0)
			{
				Max7219_pinDIN_L;
			}
			else
			{
				Max7219_pinDIN_H;
			}
			//HAL_Delay_us(2);
			DATA=DATA<<1;
			Max7219_pinCLK_H;	
			//HAL_Delay_us(2);
	}                                 
}
//-------------------------------------------
//功能：向MAX7219写入数据
//入口参数：address、dat
//出口参数：无
//说明：
void Write_Max7219(unsigned char address,unsigned char dat)
{ 
   Max7219_pinCS_L;
	 Write_Max7219_byte(address);           //写入地址，即数码管编号
	 HAL_Delay_us(10);
   Write_Max7219_byte(dat);               //写入数据，即数码管显示数字
	 HAL_Delay_us(10);	
	 Max7219_pinCS_H;                        
}


void Init_MAX7219(void)
{
	 GPIO_InitTypeDef GPIO_Initure;
	 __HAL_RCC_GPIOE_CLK_ENABLE();			
	 GPIO_Initure.Pin=GPIO_PIN_10|GPIO_PIN_12|GPIO_PIN_15; 
	 GPIO_Initure.Mode=GPIO_MODE_OUTPUT_PP;  	
	 GPIO_Initure.Pull=GPIO_PULLUP;         
	 GPIO_Initure.Speed=GPIO_SPEED_HIGH;    
	 HAL_GPIO_Init(GPIOE,&GPIO_Initure);
	
	 Write_Max7219(0x09, 0x00);       //译码方式：BCD码
	 Write_Max7219(0x0a, 0x03);       //亮度 
	 Write_Max7219(0x0b, 0x06);       //扫描界限；8个数码管显示
	 Write_Max7219(0x0c, 0x01);       //掉电模式：0，普通模式：1
	 Write_Max7219(0x0f, 0x00);       //显示测试：1；测试结束，正常显示：0
}


void max7219_test(void)
{
	 unsigned char i,j;
	 HAL_Delay(50);
//	 Init_MAX7219();  
	
	 while(1)
	 {

		for(j=0;j<39;j++)
		{
		 for(i=1;i<6;i++)
			{
			Write_Max7219(i,(disp1[j][i-1])<<1);
			}
			HAL_Delay(1000);
		} 

 
	 }

 }
